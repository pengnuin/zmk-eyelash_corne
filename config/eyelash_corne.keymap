#include <behaviors.dtsi>
#include <behaviors/num_word.dtsi>
#include <behaviors/unicode.dtsi>
#include <zmk-helpers/helper.h>
#include <dt-bindings/zmk/keys.h>
#include <dt-bindings/zmk/bt.h>
#include <dt-bindings/zmk/pointing.h>
#include <dt-bindings/zmk/rgb.h>

#define _BT_SEL_KEYS_ &bt BT_SEL 0 &bt BT_SEL 1 &bt BT_SEL 2 &bt BT_SEL 3 &bt BT_CLR

#define DEF   0
#define NAV   1
#define NUM   2
#define FN    3
#define GAME  4
#define MOUSE 5

#define XXX &none
#define ___ &trans
/* Global defaults */

#define QUICK_TAP_MS 175

&sk {
  release-after-ms = <900>;
  quick-release;
};

&sl { // Allow sticky mods to chord across sticky layers.
  ignore-modifiers;
};

&lt {
  flavor = "balanced";
  tapping-term-ms = <200>;
  quick-tap-ms = <QUICK_TAP_MS>;
};

/* Homerow mods */

#define HRM_TERM_MS 280 // Hold-tap timeout: raise it if mods trigger by accident.
#define HRM_IDLE_MS 200 // A home-row key pressed this soon after another key is always a tap.

#define KEYS_L   0  1  2  3  4  5   13 14 15 16 17 18   28 29 30 31 32 33
#define KEYS_R   7  8  9 10 11 12   22 23 24 25 26 27   36 37 38 39 40 41
#define THUMBS  42 43 44            45 46 47
#define JOY      6 19 20 21 35 // Joystick: UP, LEFT, ENTER, RIGHT, DOWN.

#define MAKE_HRM(NAME, HOLD, TAP, TRIGGER_POS)                                 \
  ZMK_HOLD_TAP(NAME, bindings = <HOLD>, <TAP>; flavor = "balanced";            \
               tapping-term-ms = <HRM_TERM_MS>; quick-tap-ms = <QUICK_TAP_MS>; \
               require-prior-idle-ms = <HRM_IDLE_MS>; hold-trigger-on-release; \
               hold-trigger-key-positions = <TRIGGER_POS>;)

MAKE_HRM(hml, &kp, &kp, KEYS_R THUMBS JOY) // Left-hand HRMs.
MAKE_HRM(hmr, &kp, &kp, KEYS_L THUMBS JOY) // Right-hand HRMs.

// Hack: Make HRM combos tap-only (cf, ZMK issue #544).
#define ZMK_COMBO_8(NAME, TAP, POS, LAYERS, COMBO_MS, IDLE_MS, HOLD, SIDE)     \
  MAKE_HRM(hm_combo_##NAME, &kp, TAP, SIDE THUMBS JOY)                         \
  ZMK_COMBO_6(NAME, &hm_combo_##NAME HOLD 0, POS, LAYERS, COMBO_MS, IDLE_MS)

/* Leader key sequences, mouse emulation */

#include "leader.dtsi"
#include "mouse.dtsi"

/* Nav cluster */

// Trigger tap-action on all interrupts.
#define MT_CORE                                                                \
  flavor = "tap-preferred";                                                    \
  tapping-term-ms = <220>;                                                     \
  quick-tap-ms = <220>;                                                        \
  hold-trigger-key-positions = <0>;

&mt { MT_CORE };

ZMK_HOLD_TAP(mt_home, bindings = <&masked_home>, <&kp>; MT_CORE)
ZMK_HOLD_TAP(mt_end, bindings = <&masked_end>, <&kp>; MT_CORE)

#define NAV_LEFT  &mt_home 0   LEFT  // Tap: left  | Long-tap: start of line.
#define NAV_RIGHT &mt_end 0    RIGHT // Tap: right | Long-tap: end   of line.
#define NAV_UP    &mt LC(HOME) UP    // Tap: up    | Long-tap: start of doc.
#define NAV_DOWN  &mt LC(END)  DOWN  // Tap: down  | Long-tap: end   of doc.
#define NAV_BSPC  &mt LC(BSPC) BSPC  // Tap: bspc  | Long-tap: delete word bwd.
#define NAV_DEL   &mt LC(DEL)  DEL   // Tap: del   | Long-tap: delete word fwd.

// Mask CTRL on left/right hold to avoid accidental jumps to start/end of doc.
#define MASK_MODS(NAME, MODS, BINDING)                                         \
  ZMK_MOD_MORPH(NAME, bindings = <BINDING>, <BINDING>; mods = <MODS>;)

MASK_MODS(masked_home, (MOD_LCTL), &kp HOME)
MASK_MODS(masked_end,  (MOD_LCTL), &kp END)

/* Magic-shift & auto-layers */

// Tap: repeat after alpha, else sticky-shift |
// Shift + tap/ double-tap: caps-word | Hold: shift.
#define MAGIC_SHIFT &magic_shift LSHFT 0
ZMK_HOLD_TAP(magic_shift, bindings = <&kp>, <&magic_shift_tap>;
             flavor = "balanced"; tapping-term-ms = <200>;
             quick-tap-ms = <QUICK_TAP_MS>;)
ZMK_MOD_MORPH(magic_shift_tap, bindings = <&shift_repeat>, <&caps_word>;
              mods = <(MOD_LSFT)>;)
ZMK_ADAPTIVE_KEY(
    shift_repeat, bindings = <&sk LSHFT>;
    repeat {
      trigger-keys = <A B C D E F G H I J K L M N O P Q R S T U V W X Y Z>;
      bindings = <&key_repeat>;
      max-prior-idle-ms = <1200>;
      strict-modifiers;
    };)
&caps_word { // Mods deactivate caps-word, requires PR #1451. [TODO: rebase]
  /delete-property/ ignore-modifiers;
};

// Tap: num-word | double-tap: sticky num-layer | Hold: num-layer.
#define SMART_NUM &smart_num NUM 0
ZMK_HOLD_TAP(smart_num, bindings = <&mo>, <&num_dance>; flavor = "balanced";
             tapping-term-ms = <200>; quick-tap-ms = <QUICK_TAP_MS>;)
ZMK_TAP_DANCE(num_dance, bindings = <&num_word NUM>, <&sl NUM>;
              tapping-term-ms = <200>;)

// Smart-mouse, requires tri-state module.
ZMK_TRI_STATE(
    smart_mouse, bindings = <&tog MOUSE>, <&none>, <&tog MOUSE>;	
    ignored-layers = <MOUSE NAV FN>;
    ignored-key-positions = <
        6 19 20 21 35     // Center Joystick
        23 24 25          // Right Hand Click Keys
        42 43 44 45 46 47 // All 6 Thumb Keys
    >;
)

/* Custom behaviors */

// Alt+Tab swapper, requires tri-state module.
ZMK_TRI_STATE(swapper, bindings = <&kt LALT>, <&kp TAB>, <&kt LALT>;
    ignored-key-positions = <
        17 23             // Left Shift (F) & Right Shift (J)
        6 19 20 21 35     // Center Joystick: UP, LEFT, ENTER, RIGHT, DOWN
        22 24 25          // Right hand H, K, L arrows
    >;
)

// Define mod-morph with a *single* mod trigger for less repetition.
#define SIMPLE_MORPH(NAME, MOD, BINDING1, BINDING2)                            \
  ZMK_MOD_MORPH(NAME, mods = <(MOD_L##MOD | MOD_R##MOD)>;                      \
                bindings = <BINDING1>, <BINDING2>;)

// Tap: comma | Shift + tap: semicolon | Ctrl + shift + tap: <.
SIMPLE_MORPH(comma_morph, SFT, &kp COMMA, &comma_inner_morph)
SIMPLE_MORPH(comma_inner_morph, CTL, &kp SEMICOLON, &kp LESS_THAN)

// Tap: dot | Shift + tap: colon | Ctrl + shift + tap: >.
SIMPLE_MORPH(dot_morph, SFT, &kp DOT, &dot_inner_morph)
SIMPLE_MORPH(dot_inner_morph, CTL, &kp COLON, &kp GREATER_THAN)

// Tap: qmark | Shift + tap: excl.
SIMPLE_MORPH(qexcl, SFT, &kp QMARK, &kp EXCL)

// Tap: left/right parenthesis | Shft + tap: less-than/greater-than.
SIMPLE_MORPH(lpar_lt, SFT, &kp LPAR, &kp LT)
SIMPLE_MORPH(rpar_gt, SFT, &kp RPAR, &kp GT)

// Tap: space | Shift + tap: dot -> space -> sticky shift | Hold: nav layer.
ZMK_HOLD_TAP(lt_spc, bindings = <&mo>, <&spc_morph>; flavor = "balanced";
             tapping-term-ms = <200>; quick-tap-ms = <QUICK_TAP_MS>;)
SIMPLE_MORPH(spc_morph, SFT, &kp SPACE, &dot_spc)
ZMK_MACRO(dot_spc, bindings = <&kp DOT &kp SPACE &sk LSHFT>; wait-ms = <0>;
          tap-ms = <5>;)

// Tap: backspace | Lshft + tap: delete | Rshft + tap: shift-delete.
ZMK_MOD_MORPH(bs_del, bindings = <&kp BSPC>, <&kp DEL>;
              mods = <(MOD_LSFT|MOD_RSFT)>; keep-mods = <MOD_RSFT>;)

// Tap: copy | double-tap: cut.
ZMK_TAP_DANCE(copy_cut, bindings = <&kp LC(INS)>, <&kp LC(X)>;
              tapping-term-ms = <200>;)

// Sticky shift + leader.
ZMK_MACRO(leader_sft, bindings = <&sk LSHFT &leader>;)

// Misc aliases.
#define CANCEL    &kp K_CANCEL            // Cancel caps-word & auto-layers.
#define DSK_PREV  &hmr LCTRL LG(LC(LEFT)) // Previous desktop.
#define DSK_NEXT  &hmr LALT LG(LC(RIGHT)) // Next     desktop.
#define PIN_WIN   &kp LG(LC(LS(Q)))       // Pin window across desktops.
#define PIN_APP   &kp LG(LC(LS(A)))       // Pin application across desktops.
#define DSK_MGR   &kp LA(GRAVE)           // Desktop manager.
#define VOL_DOWN  &hmr RSHFT C_VOL_DN

/* Combos */

#include "combos.dtsi" // Must be sourced after the HRM-combo hack and the aliases above.

/ {
  behaviors {
    rsr_vol: rsr_vol {
      compatible = "zmk,behavior-runtime-sensor-rotate";
      #sensor-binding-cells = <0>;
      tap-ms = <5>;
      cw-binding = <&kp C_VOL_UP>;
      ccw-binding = <&kp C_VOL_DN>;
    };

    rsr_trans: rsr_trans {
      compatible = "zmk,behavior-runtime-sensor-rotate";
      #sensor-binding-cells = <0>;
      tap-ms = <0>;
    };
  };
};


/* Keymap */

/ {
  keymap {
    compatible = "zmk,keymap";

    Base {
      display-name = "QWERTY";
      bindings = <
    &kp TAB         &kp Q           &kp W           &kp E           &kp R           &kp T                           &kp UP                          &kp Y           &kp U           &kp I           &kp O           &kp P           &bs_del
    &kp ESC         &hml LGUI A     &hml LALT S     &hml LCTRL D    &hml LSHFT F    &kp G           &kp LEFT        &kp ENTER       &kp RIGHT       &kp H           &hmr RSHFT J    &hmr RCTRL K    &hmr RALT L     &hmr RGUI SEMI  &kp SQT
    &kp GRAVE       &kp Z           &kp X           &kp C           &kp V           &kp B           &kp C_MUTE      &kp DOWN                        &kp N           &kp M           &comma_morph    &dot_morph      &qexcl          &kp ENTER
                                                    MAGIC_SHIFT     SMART_NUM       &kp SPACE                                                       &lt FN ESC      &mo NAV         &swapper
      >;
      sensor-bindings = <&rsr_vol &rsr_trans>;
    };

    Nav {
      display-name = "NAV/CLIP";
      bindings = <
    ___             ___             ___             ___             ___             ___                             &mmv MOVE_UP                    &kp LC(Z)       &kp LC(X)       &kp LC(C)       &kp LC(V)       &kp LC(A)       NAV_DEL
    ___             ___             ___             ___             ___             ___             &mmv MOVE_LEFT  &mkp LCLK       &mmv MOVE_RIGHT NAV_LEFT        NAV_DOWN        NAV_UP          NAV_RIGHT       &kp HOME        &kp END
    ___             ___             ___             ___             ___             ___             ___             &mmv MOVE_DOWN                  &kp PG_DN       &kp PG_UP       &kp INS         ___             ___             ___
                                                    ___             ___             ___                                                             ___             ___             ___
      >;
      sensor-bindings = <&rsr_vol &rsr_trans>;
    };

    Num {
      display-name = "NUM/SYM";
      bindings = <
    ___             &kp EXCL        &kp AT          &kp HASH        &kp DLLR        &kp PRCNT                       &mmv MOVE_UP                    &kp MINUS       &kp N7          &kp N8          &kp N9          &kp EQUAL       &kp BSPC
    ___             ___             &mkp LCLK       &mkp MCLK       &mkp RCLK       &mkp MB4        &mmv MOVE_LEFT  &mkp LCLK       &mmv MOVE_RIGHT &kp LBKT        &kp N4          &kp N5          &kp N6          &kp RBKT        &kp BSLH
    ___             ___             ___             XXX             XXX             &mkp MB5        ___             &mmv MOVE_DOWN                  &kp N0          &kp N1          &kp N2          &kp N3          &kp DOT         ___
                                                    ___             ___             ___                                                             ___             &kp RET         ___
      >;
      sensor-bindings = <&rsr_vol &rsr_trans>;
    };

    Fn {
      display-name = "FN/SYS";
      bindings = <
    &studio_unlock  &kp F1          &kp F2          &kp F3          &kp F4          &kp F5                          &mmv MOVE_UP                    &kp F6          &kp F7          &kp F8          &kp F9          &kp F10         &to GAME
    ___             _BT_SEL_KEYS_                                                                   &mmv MOVE_LEFT  &mkp LCLK       &mmv MOVE_RIGHT &kp F11         &mkp LCLK       &mkp MCLK       &mkp RCLK       &kp PRINTSCREEN &kp F12
    ___             &sys_reset      ___             &bootloader     ___             &mkp MB5        ___             &mmv MOVE_DOWN                  ___             ___             &bootloader     &sys_reset      &kp SCROLLLOCK  &kp PAUSE_BREAK
                                                    ___             ___             ___                                                             ___             ___             ___
      >;
      sensor-bindings = <&rsr_vol &rsr_trans>;
    };

    Game {
      display-name = "GAMING";
      bindings = <
    ___             ___             ___             ___             ___             ___                             &kp N1                          &kp R           &kp Q           &kp N           &kp E           &kp T           &kp TAB
    ___             ___             ___             ___             ___             ___             &kp N2          &kp N5          &kp N4          &kp F           &kp A           &kp W           &kp D           &kp G           &kp LSHIFT
    ___             ___             ___             ___             ___             ___             ___             &kp N3                          &kp B           &kp X           &kp S           &kp C           &kp M           &kp /
                                                    ___             ___             ___                                                             &kp SPACE       &to DEF         ___
      >;
      sensor-bindings = <&rsr_vol &rsr_trans>;
    };
  };
};

/* vim: set ft=c tw=250: */
